## drivers/misc/mediatek/systracker/Kconfig
```kconfig
config MTK_SYSTRACKER_DISABLE
	bool "Disable all systracker services"
	default y
	help
	  Disable the Mediatek systracker debugging feature

config MTK_SYSTRACKER_V2
	bool "Enable MTK System Tracker Debugger V2"
	select MTK_SYSTRACKER
	default n
	help
	  SYSTRACKER driver is a debugging feature.
	  SYSTRACKER is a hardware debugger to record timeout transaction
	  and trigger SLV_ERR or interrupt to notify CPU.
	  Support 2 stage timeout & watchpoint SLV_ERR
```
